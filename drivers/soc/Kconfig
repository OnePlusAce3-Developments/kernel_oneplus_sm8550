## drivers/soc/Kconfig
```kconfig
# SPDX-License-Identifier: GPL-2.0-only
menu "SOC (System On Chip) specific Drivers"

source "drivers/soc/actions/Kconfig"
source "drivers/soc/amlogic/Kconfig"
source "drivers/soc/aspeed/Kconfig"
source "drivers/soc/atmel/Kconfig"
source "drivers/soc/bcm/Kconfig"
source "drivers/soc/canaan/Kconfig"
source "drivers/soc/fsl/Kconfig"
source "drivers/soc/imx/Kconfig"
source "drivers/soc/ixp4xx/Kconfig"
source "drivers/soc/litex/Kconfig"
source "drivers/soc/mediatek/Kconfig"
source "drivers/soc/qcom/Kconfig"
source "drivers/soc/renesas/Kconfig"
source "drivers/soc/rockchip/Kconfig"
source "drivers/soc/samsung/Kconfig"
source "drivers/soc/sifive/Kconfig"
source "drivers/soc/sunxi/Kconfig"
source "drivers/soc/tegra/Kconfig"
source "drivers/soc/ti/Kconfig"
source "drivers/soc/ux500/Kconfig"
source "drivers/soc/versatile/Kconfig"
source "drivers/soc/xilinx/Kconfig"

#ifdef OPLUS_BUG_STABILITY
source "drivers/soc/oplus/system/Kconfig"
#endif /* OPLUS_BUG_STABILITY */

#ifdef OPLUS_FEATURE_SENSOR_SMEM
#qiuzuolin@BSP.Sensor.Basic 2020/07/31 add for oplus sensor smem
source "drivers/soc/oplus/sensor/Kconfig"
#endif /* OPLUS_FEATURE_SENSOR_SMEM */

#ifdef OPLUS_FEATURE_DFT
source "drivers/soc/oplus/dft/Kconfig"
#endif /* ifdef OPLUS_FEATURE_DFT */

#ifdef OPLUS_FEATURE_BOOT
source "drivers/soc/oplus/boot/Kconfig"
#endif /* OPLUS_FEATURE_BOOT */

#ifdef OPLUS_FEATURE_OCH
#shenshen.Mao@Kernel.Power, 2021/09/24, add for cpufreq health
source "kernel/oplus_cpu/cpufreq_health/Kconfig"
#endif /* OPLUS_FEATURE_OCH */

endmenu

#ifdef OPLUS_FEATURE_TP_BASIC
source "drivers/soc/oplus/device_info/Kconfig"
#endif /* OPLUS_FEATURE_TP_BASIC */
```
